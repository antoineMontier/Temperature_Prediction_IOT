#include <Arduino.h>
#include <string.h>
#include <math.h>
#include "DHT.h"

/*
 Dirty single-file model runner.
 Model architecture:
  input: 48
  dense_4: 32  (activation: ReLU)
  dense_5: 16  (activation: ReLU)
  dense_6: 8   (activation: ReLU)
  dense_7: 1   (activation: linear)
 
*/

// sizes
#define IN_SZ 48
#define L0_SZ 32
#define L1_SZ 16
#define L2_SZ 8
#define OUT_SZ 1
#define DHTPIN 7
#define DHTTYPE DHT11
#define SAMPLING_INTERVAL 30 // min




DHT dht(DHTPIN, DHTTYPE);

int previous_temperature[IN_SZ];
int next_temperature    [IN_SZ];

int temp;

inline void applyColor (int r, int g, int b);

// Scaler parameters
static const float SCALER_MIN = -5.0f;
static const float SCALER_MAX = 25.0f;
static const float SCALER_RANGE = SCALER_MAX - SCALER_MIN;

// ---- placeholder weights/biases (row-major: weights[layer_out_index * in_size + in_index]) ---- // obtained from model_weights_extractor.py

// layer dense_4: kernel (32 x 48), bias (32)
static const float W_dense_4[1536] = { +1.94174752e-01f, +1.68859009e-02f, -2.48415202e-01f, -3.30679826e-02f, -2.48247936e-01f, -2.64938325e-01f, +2.45976150e-01f, +8.63572806e-02f, +2.86271125e-02f, +2.04796091e-01f, +1.54858962e-01f, -3.88294421e-02f, -1.33820459e-01f,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 +4.14205454e-02f, -3.14342231e-01f };

static const float B_dense_4[32] = { -2.19995696e-02f, -3.82701047e-02f, -3.41743492e-02f, +1.29234474e-02f, -3.25342268e-02f, -7.88602754e-02f, -2.77026221e-02f, +5.96694741e-03f, -1.85105335e-02f, -1.94767248e-02f, +1.09021127e-01f, +3.36977206e-02f, +1.05580457e-01f, -1.66578628e-02f, +6.73750555e-03f, -4.86906618e-02f, -3.68730128e-02f, -1.86489634e-02f, +7.32219964e-02f, -2.81041209e-02f, +1.61647379e-01f, +0.00000000e+00f, -3.94701846e-02f, +0.00000000e+00f, -1.07924178e-01f, +4.32421826e-03f, +6.89126477e-02f, -4.59935553e-02f, -7.06480816e-03f, +5.37734292e-02f, -2.58052871e-02f, -3.39137018e-02f };

// layer dense_5: kernel (16 x 32), bias (16)
static const float W_dense_5[512] = { +1.45745769e-01f, -4.48842913e-01f, +1.01829223e-01f, +1.69079468e-01f, -3.45332056e-01f, +5.81595302e-02f, -2.88813114e-01f, -2.54350543e-01f, +6.53019315e-03f, -2.27978155e-01f, -7.18937665e-02f, -3.20449144e-01f, -1.90585449e-01f,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 +3.14568222e-01f, +2.74222493e-01f };

static const float B_dense_5[16] = { -1.20899081e-01f, +8.67468789e-02f, -3.75403613e-02f, -2.86841709e-02f, -8.81063342e-02f, -8.92776176e-02f, +4.09868062e-02f, -9.27784815e-02f, -6.89897165e-02f, -5.91558516e-02f, +1.70825329e-02f, -1.32401451e-01f, -6.46298900e-02f, -1.07202955e-01f, -1.77239910e-01f, -2.65072048e-01f };

// layer dense_6: kernel (8 x 16), bias (8)
static const float W_dense_6[128] = { +3.59676510e-01f, +3.14272732e-01f, +4.89570409e-01f, -5.13341010e-01f, -1.29059806e-01f, +4.36485484e-02f, -8.34141910e-01f, +1.24819584e-01f, -2.27384329e-01f, +9.95769203e-02f, -8.59610558e-01f, -1.23753659e-01f, +1.55587047e-02f,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 -1.13886893e-02f, -1.11114174e-01f };

static const float B_dense_6[8] = { +1.97103806e-02f, -8.25126246e-02f, +1.88598298e-02f, +4.00540797e-04f, +1.26041517e-01f, -4.15385291e-02f, -1.52323544e-01f, +6.96478188e-02f };

// layer dense_7: kernel (1 x 8), bias (1)
static const float W_dense_7[8] = { -9.82690528e-02f, -2.21001863e-01f, +7.82366931e-01f, +5.72856655e-03f, -1.76731244e-01f, -1.83746770e-01f, -6.41175956e-02f, -2.28180572e-01f };

static const float B_dense_7[1] = { +5.88153265e-02f };

// ---- internal buffers ----
static float input_raw[IN_SZ];
static float input_scaled[IN_SZ];
static float buf0[L0_SZ];
static float buf1[L1_SZ];
static float buf2[L2_SZ];
static float out_scaled[OUT_SZ];

// ---- helpers ----
static inline float relu(float x) { return x > 0.0f ? x : 0.0f; }

// Dense layer: out[o] = activation( sum_i weights[o*in_sz + i] * in[i] + bias[o] )
static void dense_layer(const float *in, int in_sz, const float *weights, const float *bias, int out_sz, float *out, int apply_relu) {
    for (int o = 0; o < out_sz; ++o) {
        float s = bias ? bias[o] : 0.0f;
        const float *wrow = weights + o * in_sz;
        for (int i = 0; i < in_sz; ++i) {
            s += wrow[i] * in[i];
        }
        out[o] = apply_relu ? relu(s) : s;
    }
}

// scale input from °C -> [0,1] using notebook's MinMaxScaler
static void scale_input(const float raw[IN_SZ], float scaled[IN_SZ]) {
    for (int i = 0; i < IN_SZ; ++i) {
        scaled[i] = (raw[i] - SCALER_MIN) / SCALER_RANGE;
    }
}

// inverse scale single output value (from [0,1] -> °C)
static float inverse_scale_output(float scaled_val) {
    return scaled_val * SCALER_RANGE + SCALER_MIN;
}

// ---- public-ish API requested: feed, run, get output ----

// Feed raw input (48 values in °C)
void model_feed_input(const float in[IN_SZ]) {
    memcpy(input_raw, in, sizeof(input_raw));
    scale_input(input_raw, input_scaled);
}

// Execute forward pass (take input_scaled -> out_scaled)
void model_run(void) {
    // layer 0: 48 -> 32 (ReLU)
    dense_layer(input_scaled, IN_SZ, W_dense_4, B_dense_4, L0_SZ, buf0, 1);

    // layer 1: 32 -> 16 (ReLU)
    dense_layer(buf0, L0_SZ, W_dense_5, B_dense_5, L1_SZ, buf1, 1);

    // layer 2: 16 -> 8 (ReLU)
    dense_layer(buf1, L1_SZ, W_dense_6, B_dense_6, L2_SZ, buf2, 1);

    // layer 3: 8 -> 1 (linear)
    dense_layer(buf2, L2_SZ, W_dense_7, B_dense_7, OUT_SZ, out_scaled, 0);
}

// Retrieve unscaled output °C
float model_get_output_celsius(void) {
    return inverse_scale_output(out_scaled[0]);
}

// Alternative : retrieve scaled output (0..1)
float model_get_output_scaled(void) {
    return out_scaled[0];
}

float RunInterference(float data[IN_SZ]) {
    model_feed_input(data);
    model_run();
    return model_get_output_celsius();
}

static float RunInferenceScaled_scaled(const float scaled_input[IN_SZ]) {
  memcpy(input_scaled, scaled_input, sizeof(input_scaled));
  model_run();
  return model_get_output_scaled(); // returns the output in [0..1]
}

// NextPredictions variant that works like the Python recursive loop (operates in scaled domain)
void NextPredictions_scaled_from_raw(const float data_raw[IN_SZ], int result[IN_SZ]) {
  // allocate arrays
  float* res_scaled = new float[IN_SZ];         // holds scaled sequence, mutated
  float* out_denorm = new float[IN_SZ];         // final denormalized predictions to return

  // init scaled buffer from raw input
  for (size_t i = 0; i < IN_SZ; ++i) res_scaled[i] = (data_raw[i] - SCALER_MIN) / SCALER_RANGE;

  for (size_t step = 0; step < IN_SZ; ++step) {
    float next_scaled = RunInferenceScaled_scaled(res_scaled);

    // shift left
    for (size_t i = 1; i < IN_SZ; ++i) res_scaled[i - 1] = res_scaled[i];

    // append predicted scaled value
    res_scaled[IN_SZ - 1] = next_scaled;

    // also store the denormalized prediction in out_denorm[step]
    out_denorm[step] = next_scaled * SCALER_RANGE + SCALER_MIN;
  }

  // Print for debug
  Serial.println("Predictions (denorm):");
  for (size_t i = 0; i < IN_SZ; ++i) {
    Serial.print("  out[");
    Serial.print(i);
    Serial.print("] = ");
    Serial.println(out_denorm[i], 6);
  }

  for (size_t i = 0; i < IN_SZ; ++i) result[i] = int(out_denorm[i]);

  delete[] res_scaled; // free temp
  delete[] out_denorm;   // caller must delete[] when done
}


void setup() {

    Serial.begin(9600);
    while (!Serial) { delay(1); }

    Serial.println("\nIn setup()\n\n");
    pinMode(LEDR, OUTPUT);
    pinMode(LEDG, OUTPUT);
    pinMode(LEDB, OUTPUT);
    applyColor(0, 0, 128);

    dht.begin();
    Serial.println("DHT has began");    
    
    // INITIALIZE the 2 arrays
    float intial_array[] = { // initial data to set up model inputs, typically the last 48 records (=24h)
        13.3,13.1,12.8,12.6,12.0,11.9,12.2,12.8,14.2,15.5,16.3,
        16.8,16.9,16.9,16.6,16.3,15.7,14.8,14.2,13.8,13.9,13.5,
        13.0,12.6,12.4,12.1,12.1,11.9,11.7,11.8,12.7,13.1,13.8,
        14.5,15.0,15.6,15.6,15.7,15.8,15.8,15.6,15.0,14.2,13.9,
        13.6,13.1,13.0,12.9
    };

    Serial.println("initializing array");    

    for (size_t i = 0 ; i < IN_SZ ; ++i){
        previous_temperature[i] = intial_array[i];
        next_temperature[i] = 0x00; // example value
    }
    Serial.println("array initialized");    

    applyColor(0, 0, 255);
    Serial.println("Service is running !");
}

void loop() {
    size_t cpt = 0;
    applyColor(0, 0, 0);
    while(1){
        Serial.println("[SEN] Reading sensors");

        temp = int(dht.readTemperature());
        // add temp to previous_temp
        for (size_t i = 2 ; i < IN_SZ ; ++i) previous_temperature[i-1] = previous_temperature[i];
        
        float f_argument[IN_SZ];
        for (size_t i = 0 ; i < IN_SZ ; ++i) f_argument[i] = float(previous_temperature[i]); // cast to float
        // from previous_temp, recompute next_temp (we must recompute it each time).
        NextPredictions_scaled_from_raw(f_argument, next_temperature);

        Serial.print("cpt: ");
        Serial.println(cpt);
        cpt++;

        // display arrays
        Serial.println("previous_temperature:");
        for (size_t i = 0; i < IN_SZ; i++) {
            Serial.print(previous_temperature[i]);
            if ((i + 1) % 12 == 0) Serial.println();
            else Serial.print(", ");
        }
        Serial.println();

        Serial.println("next_temperature:");
        for (size_t i = 0; i < IN_SZ; i++) {
            Serial.print(next_temperature[i]);
            if ((i + 1) % 12 == 0) Serial.println();
            else Serial.print(", ");
        }
        Serial.println();

        for(size_t sec = 0 ; sec < SAMPLING_INTERVAL*60 ; ++sec){
            delay(900);
            applyColor(25, 125, 35);
            delay(100);
            applyColor(0, 0, 0);
        }

    }
}

inline void applyColor(int r, int g, int b) {
  analogWrite(LEDR, 255 - r);
  analogWrite(LEDG, 255 - g);
  analogWrite(LEDB, 255 - b);
}